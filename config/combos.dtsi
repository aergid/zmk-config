// taken from rayduck's pnohty

#include "layers.dtsi"

compatible = "zmk,combos";
#define LONG_TIMEOUT_MS 100

#define COMBO(NAME, BINDINGS, KEYPOS) \
  combo_##NAME { \
    bindings = <BINDINGS>; \
    key-positions = <KEYPOS>; \
    layers = <NORMAL_LAYERS>; \
  };

#define COMBO_LONG(NAME, BINDINGS, KEYPOS) \
  combo_##NAME { \
    bindings = <BINDINGS>; \
    key-positions = <KEYPOS>; \
    layers = <NORMAL_LAYERS>; \
    timeout-ms = <LONG_TIMEOUT_MS>; \
  };

#define LAYER_COMBO(NAME, BINDINGS, KEYPOS, LAYERS) \
  combo_##NAME { \
    bindings = <BINDINGS>; \
    key-positions = <KEYPOS>; \
    layers = <LAYERS>; \
  };

/*           34 Keys
╭──────────────╮ ╭──────────────╮
│ 0  1  2  3  4│ │ 5  6  7  8  9│
│10 11 12 13 14│ │15 16 17 18 19│
│20 21 22 23 24│ │25 26 27 28 29│
╰────────╮30 31│ │32 33╭────────╯
         ╰─────╯ ╰─────╯         */

COMBO(lctrl, &kp LCTRL, 21 22)
COMBO(lalt, &kp LALT, 22 23)
COMBO(lcmd, &sk LGUI, 1 2)
COMBO(lshft, &kp LSHFT, 2 3)
COMBO(del, &kp DEL, 30 31)

COMBO_LONG(capsword, &caps_word, 14 15)
COMBO_LONG(esc, &kp ESC, 31 32)
LAYER_COMBO(lock, &tog LCK, 20 29 30 33, NORMAL_LAYERS LCK)

COMBO(rctrl, &kp RCTRL, 27 28)
COMBO(ralt, &kp RALT, 26 27)
COMBO(rcmd, &sk RGUI, 7 8)
COMBO(rshft, &kp RSHFT, 6 7)
COMBO(backspace, &kp BSPC, 32 33)
